## config/west.yml
```yaml
manifest:
  remotes:
    - name: zmkfirmware
      url-base: https://github.com/zmkfirmware
    - name: Junno-hand
      url-base: https://github.com/Junno-hand
    - name: caksoylar
      url-base: https://github.com/caksoylar
    - name: zettaface
      url-base: https://github.com/zettaface

  projects:
    - name: zmk
      remote: zmkfirmware
      revision: v0.3-branch
      import: app/west.yml
    - name: zmk-driver-pmw3320
      remote: Junno-hand
      revision: main
    - name: zmk-rgbled-widget
      remote: caksoylar
      revision: v0.3-branch
    - name: zmk-input-processor-keybind
      remote: zettaface
      revision: main

  self:
    path: config
```
